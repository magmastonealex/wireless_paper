## boards/ar/epaper_driver/Kconfig.epaper_driver
```kconfig
# Copyright (c) 2024 Nordic Semiconductor ASA
# SPDX-License-Identifier: Apache-2.0

config BOARD_EPAPER_DRIVER
	select SOC_NRF54L05_CPUAPP if BOARD_EPAPER_DRIVER_NRF54L05_CPUAPP
	select SOC_NRF54L10_CPUAPP if BOARD_EPAPER_DRIVER_NRF54L10_CPUAPP || BOARD_EPAPER_DRIVER_NRF54L10_CPUAPP_NS
	select SOC_NRF54L15_CPUAPP if BOARD_EPAPER_DRIVER_NRF54L15_CPUAPP || BOARD_EPAPER_DRIVER_NRF54L15_CPUAPP_NS
	select SOC_NRF54L15_CPUFLPR if BOARD_EPAPER_DRIVER_NRF54L15_CPUFLPR || \
					    BOARD_EPAPER_DRIVER_NRF54L15_CPUFLPR_XIP
```

## boards/ar/epaper_driver/board.yml
```yaml
board:
  name: epaper_driver
  full_name: epaper driver board maybe
  vendor: ar
  socs:
    - name: nrf54l15
runners:
  run_once:
    '--recover':
      - runners:
          - nrfjprog
          - nrfutil
        run: first
        groups:
          - boards:
              - epaper_driver/nrf54l15/cpuapp
    '--erase':
      - runners:
          - nrfjprog
          - jlink
          - nrfutil
        run: first
        groups:
          - boards:
              - epaper_driver/nrf54l15/cpuapp
    '--reset':
      - runners:
          - nrfjprog
          - jlink
          - nrfutil
        run: last
        groups:
          - boards:
              - epaper_driver/nrf54l15/cpuapp
```

## boards/ar/epaper_driver/epaper_driver_nrf54l15_cpuapp_defconfig
```kconfig
# Copyright (c) 2024 Nordic Semiconductor ASA
# SPDX-License-Identifier: Apache-2.0

# Enable UART driver
CONFIG_SERIAL=y

# Enable console
CONFIG_CONSOLE=y
CONFIG_UART_CONSOLE=y

# Enable GPIO
CONFIG_GPIO=y

# Enable MPU
CONFIG_ARM_MPU=y

# Enable hardware stack protection
CONFIG_HW_STACK_PROTECTION=y

CONFIG_CLOCK_CONTROL=y
CONFIG_CLOCK_CONTROL_NRF=y

# use grtc as system timer
CONFIG_NRF_GRTC_TIMER=y
CONFIG_NRF_GRTC_START_SYSCOUNTER=y

# Enable LFRC (internal RC oscillator)
CONFIG_CLOCK_CONTROL_NRF_K32SRC_RC=y
CONFIG_CLOCK_CONTROL_NRF_K32SRC_FREQUENCY=32768

# Disable LFXO (external 32kHz crystal)
CONFIG_CLOCK_CONTROL_NRF_K32SRC_XTAL=n

# Disable synthesized LFCLK from HFCLK
CONFIG_CLOCK_CONTROL_NRF_K32SRC_SYNTH=n

CONFIG_CLOCK_CONTROL_NRF_K32SRC_500PPM=y
CONFIG_CLOCK_CONTROL_NRF_K32SRC_RC_CALIBRATION=y
CONFIG_CLOCK_CONTROL_NRF_CALIBRATION_LF_ALWAYS_ON=y
```

## boards/ar/epaper_tmp/Kconfig.defconfig
```kconfig
DT_CHOSEN_Z_CODE_PARTITION := zephyr,code-partition
DT_CHOSEN_Z_SRAM_PARTITION := zephyr,sram-secure-partition


config ROM_START_OFFSET
	default 0x800 if BOOTLOADER_MCUBOOT
```

## boards/ar/epaper_tmp/board.yml
```yaml
board:
  name: epaper_driver
  full_name: E-paper driver board example
  vendor: ar
  socs:
    - name: nrf54l15
```

## boards/ar/epaper_tmp/epaper_driver_nrf54l15_cpuapp_defconfig
```kconfig
# enable uart driver
CONFIG_SERIAL=y
# enable console
CONFIG_CONSOLE=y
CONFIG_UART_CONSOLE=y

# enable GPIO
CONFIG_GPIO=y

CONFIG_ARM_MPU=y

CONFIG_HW_STACK_PROTECTION=y
```

## boards/ar/pico_demo/board.yml
```yaml
board:
  name: pico_demo
  full_name: a customized rpi pico
  vendor: ar
  socs:
    - name: rp2040
```

## boards/ar/zeph_demo/board.yml
```yaml
board:
  name: zeph_demo
  full_name: Demo board to test it out
  vendor: ar
  socs:
    - name: stm32f103xb
```

## drivers/generic_epaper/Kconfig
```kconfig
menuconfig GENERIC_EPAPER
	bool "E-Paper Driver (generic)"
    depends on DT_HAS_AR_GENERIC_EPAPER_ENABLED
    select SPI
    select GPIO
	help
	  Enable support for generic 24-pin E-Ink displays

if GENERIC_EPAPER

config GENERIC_EPAPER_INIT_PRIORITY
	int "epaper device drivers init priority"
	default 90
	help
	  epaper device drivers init priority.

module = GENERIC_EPAPER
module-str = generic_epaper
source "subsys/logging/Kconfig.template.log_config"

endif # BLINK
```

## sysbuild/mcuboot/boards/nrf54l15dk_nrf54l15_cpuapp.conf
```kconfig
# disable low frequency oscillator

CONFIG_CLOCK_CONTROL=y
CONFIG_CLOCK_CONTROL_NRF=y

# use grtc as system timer
CONFIG_NRF_GRTC_TIMER=y
CONFIG_NRF_GRTC_START_SYSCOUNTER=y

# Enable LFRC (internal RC oscillator)
CONFIG_CLOCK_CONTROL_NRF_K32SRC_RC=y
CONFIG_CLOCK_CONTROL_NRF_K32SRC_FREQUENCY=32768

# Disable LFXO (external 32kHz crystal)
CONFIG_CLOCK_CONTROL_NRF_K32SRC_XTAL=n

# Disable synthesized LFCLK from HFCLK
CONFIG_CLOCK_CONTROL_NRF_K32SRC_SYNTH=n

CONFIG_CLOCK_CONTROL_NRF_K32SRC_500PPM=y
CONFIG_CLOCK_CONTROL_NRF_K32SRC_RC_CALIBRATION=y
CONFIG_CLOCK_CONTROL_NRF_CALIBRATION_LF_ALWAYS_ON=y


# for devkit, something is pushing _just_ over the limit, yet with an identical config and partition map it doesn't on the real board?
# The strangest thing is that this _used_ to be just fine, but now is not. Maybe the settings thing (CONFIG_PM_PARTITION_SIZE_SETTINGS_STORAGE) pushed partitions around
# just wrong?
CONFIG_PM_PARTITION_SIZE_MCUBOOT=61440
CONFIG_FPROTECT=n
```
