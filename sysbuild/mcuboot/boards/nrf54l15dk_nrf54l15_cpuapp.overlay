// mcuboot specific overlay file.

// Delete JEDEC flash, not being used in this application anyways. Shrinks MCUboot down.
///delete-node/ &mx25r64;

//&spi00 {
//status = "disabled";
//};

/delete-node/ &lfxo;

&grtc {
      /delete-property/ clocks;
      /delete-property/ clock-names;
      clocks = <&pclk>;
      clock-names = "hfclock";

      owned-channels = <0 1 2 3 4 5 6 7 8 9 10 11>;
	/* Channels 7-11 reserved for Zero Latency IRQs, 3-4 for FLPR */
	child-owned-channels = <3 4 7 8 9 10 11>;
	status = "okay";
};

